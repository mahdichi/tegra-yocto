## build/conf/bblayers.conf
```bitbake
# POKY_BBLAYERS_CONF_VERSION is increased each time build/conf/bblayers.conf
# changes incompatibly
POKY_BBLAYERS_CONF_VERSION = "2"

BBPATH = "${TOPDIR}"
BBFILES ?= ""

BBLAYERS ?= " \
  /media/ma/yocto/tegra/src/meta-dvr \
  /media/ma/yocto/tegra/src/meta-tegra \
  /media/ma/yocto/tegra/src/poky/meta \
  /media/ma/yocto/tegra/src/poky/meta-poky \
  /media/ma/yocto/tegra/src/poky/meta-yocto-bsp \
  /media/ma/yocto/tegra/src/meta-openembedded/meta-oe \
  /media/ma/yocto/tegra/build/workspace \
  "
```

## src/meta-dvr/conf/layer.conf
```bitbake
# We have a conf and classes directory, add to BBPATH
BBPATH .= ":${LAYERDIR}"

# We have recipes-* directories, add to BBFILES
BBFILES += "${LAYERDIR}/recipes-*/*/*.bb \
            ${LAYERDIR}/recipes-*/*/*.bbappend"

BBFILE_COLLECTIONS += "meta-dvr"
BBFILE_PATTERN_meta-dvr = "^${LAYERDIR}/"
BBFILE_PRIORITY_meta-dvr = "6"

LAYERDEPENDS_meta-dvr = "core"
LAYERSERIES_COMPAT_meta-dvr = "kirkstone"
```
